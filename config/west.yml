## config/west.yml
```yaml
manifest:
  remotes:
    - name: zmkfirmware
      url-base: https://github.com/zmkfirmware
    - name: kim
      url-base: https://github.com/infused-kim
  projects:
    - name: zmk
      remote: kim
      revision: split-encoder
      import: app/west.yml
  self:
    path: config
```
